## config/boards/shields/Kaz/Kconfig.defconfig
```kconfig
if SHIELD_KAZ

config ZMK_KEYBOARD_NAME
    default "Kaz"

endif

if ZMK_BACKLIGHT

config PWM
    default y

config LED_PWM
    default y

endif # ZMK_BACKLIGHT
```
